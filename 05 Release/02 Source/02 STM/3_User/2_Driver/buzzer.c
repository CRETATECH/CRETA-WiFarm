/*******************************************************************************
  * @filename   : buzzer.c
  * @author     : HgN
  * @last update: July 19th, 2017
  */
/******************************************************************************/

/******************************************************************************/
/* INCLUDE */
/******************************************************************************/
#include "buzzer.h"
#include <stdbool.h>
#include <stdlib.h>

/******************************************************************************/
/* LOCAL TYPEDEFS */
/******************************************************************************/

/******************************************************************************/
/* LOCAL DEFINES */
/******************************************************************************/

/******************************************************************************/
/* PUBLIC VARIABLES */
/******************************************************************************/

/******************************************************************************/
/* LOCAL FUNCTION PROTOTYPES */
/******************************************************************************/

/******************************************************************************/
/* PUBLIC FUNCTIONS */
/******************************************************************************/
/**
 * @brief   To init buzzer, buzz for a while
 * @param   None
 */
void buzzerInit(void)
{
    gpioPinMode(BUZZER_PORT, BUZZER_PIN, GPIO_OUTPUT);
    gpioWritePin(BUZZER_PORT, BUZZER_PIN, GPIO_HIGH);
    uint32_t vTimeOut = 0xFFFF;
    while(vTimeOut--);
    gpioWritePin(BUZZER_PORT, BUZZER_PIN, GPIO_LOW);
}
/**
 * @brief   To make buzzer BEEP
 * @param   None
 */
void buzzerBeep(uint8_t pPeriod, uint8_t pTime)
{
    int i, j;
    for(i = 0; i < pTime; i++)
    {
        buzzerOn();
        j = pPeriod;
        while(j--);
        buzzerOff();
        j = pPeriod;
        while(j--);
    }
}
/**
 * @brief   To turn buzzer ON
 * @param   None
 */
void buzzerOn(void)
{
    gpioWritePin(BUZZER_PORT, BUZZER_PIN, GPIO_HIGH);
}
/**
 * @brief   To turn buzzer OFF
 * @param   None
 */
void buzzerOff(void)
{
    gpioWritePin(BUZZER_PORT, BUZZER_PIN, GPIO_LOW);
}
/******************************************************************************/
/* LOCAL FUNCTIONS */
/******************************************************************************/

/******************************************************************************/
/* END OF FILE */
/******************************************************************************/
